## Documentation/devicetree/bindings/powerpc/fsl/cpm_qe/tdm.txt
```
* TDM

Currently defined compatibles:
- fsl,ucc-tdm

Time Division Multiplex, pins:

RXD, TXD, RQ, TSYNC, RSYNC, RX_CLK, TX_CLK.


Example:
	tdma: ucc@2000 {
		compatible = "fsl,ucc-tdm";
		rx-clock-name = "clk8";
		tx-clock-name = "clk9";
		fsl,rx-sync-clock = "rsync_pin";
		fsl,tx-sync-clock = "tsync_pin";
		fsl,tx-timeslot = <0xfffffffe>;
		fsl,rx-timeslot = <0xfffffffe>;
		fsl,tdm-framer-type = "e1";
		fsl,tdm-mode = "normal";
		fsl,tdm-id = <0>;
		fsl,siram-entry-id = <0>;
	};
```

## drivers/soc/fsl/ls/Kconfig
```kconfig
#
# Layerscape Soc drivers
#
config  FTM_ALARM
	bool "FTM alarm driver"
	depends on SOC_LS1021A || ARCH_FSL_LS2085A || ARCH_FSL_LS1043A
	default n
	help
	Say y here to enable FTM alarm support.  The FTM alarm provides
	alarm functions for wakeup system from deep sleep.  There is only
	one FTM can be used in ALARM(FTM 0).

config	FSL_PM_LS1
	bool "Support Power Management on LS1"
	depends on SUSPEND
	help
	Say y here to enable Power Management support for LS1, for example,
	ls1043a.
```
